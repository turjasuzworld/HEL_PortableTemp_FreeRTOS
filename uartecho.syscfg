/**
 * These arguments were used when this file was generated. They will be automatically applied on subsequent loads
 * via the GUI or CLI. Run CLI with '--help' for additional information on how to override these arguments.
 * @cliArgs --board "/ti/boards/MSP_EXP432E401Y" --product "simplelink_msp432e4_sdk@4.20.00.12"
 * @versions {"tool":"1.20.0+3587"}
 */

/**
 * Import the modules used in this configuration.
 */
const GPIO   = scripting.addModule("/ti/drivers/GPIO");
const GPIO1  = GPIO.addInstance();
const GPIO2  = GPIO.addInstance();
const GPIO3  = GPIO.addInstance();
const GPIO4  = GPIO.addInstance();
const RTOS   = scripting.addModule("/ti/drivers/RTOS");
const SPI    = scripting.addModule("/ti/drivers/SPI", {}, false);
const SPI1   = SPI.addInstance();
const UART   = scripting.addModule("/ti/drivers/UART");
const UART1  = UART.addInstance();
const UART2  = scripting.addModule("/ti/drivers/UART2", {}, false);
const UART21 = UART2.addInstance();

/**
 * Write custom configuration values to the imported modules.
 */
GPIO1.$hardware = system.deviceData.board.components.D1;
GPIO1.$name     = "CONFIG_GPIO_LED_0";

GPIO2.$name           = "TW_ESP01_RST";
GPIO2.mode            = "Output";
GPIO2.gpioPin.$assign = "boosterpack.17";

GPIO3.$name           = "TW_ESP01_EN";
GPIO3.mode            = "Output";
GPIO3.gpioPin.$assign = "boosterpack.18";

GPIO4.$name     = "CONFIG_GPIO_LED_1";
GPIO4.$hardware = system.deviceData.board.components.D2;

RTOS.name = "FreeRTOS";

SPI1.$name                = "CONFIG_SPI_MASTER";
SPI1.mode                 = "Four Pin SS Active Low";
SPI1.defaultTxBufferValue = "0xFFFF";
SPI1.spi.$assign          = "SSI2";

UART1.$name = "CONFIG_UART_0";

UART21.$name = "CONFIG_UART2_0";

/**
 * Pinmux solution for unlocked pins/peripherals. This ensures that minor changes to the automatic solver in a future
 * version of the tool will not impact the pinmux you originally saw.  These lines can be completely deleted in order to
 * re-solve from scratch.
 */
GPIO1.gpioPin.$suggestSolution            = "expansion.87";
GPIO4.gpioPin.$suggestSolution            = "expansion.85";
SPI1.spi.sclkPin.$suggestSolution         = "boosterpack.7";
SPI1.spi.misoPin.$suggestSolution         = "boosterpack.14";
SPI1.spi.mosiPin.$suggestSolution         = "boosterpack.15";
SPI1.spi.dmaRxChannel.$suggestSolution    = "UDMA_CH12";
SPI1.spi.dmaTxChannel.$suggestSolution    = "UDMA_CH13";
SPI1.spi.ssPin.$suggestSolution           = "boosterpack2.2";
UART1.uart.$suggestSolution               = "UART7";
UART1.uart.txPin.$suggestSolution         = "boosterpack.4";
UART1.uart.rxPin.$suggestSolution         = "boosterpack.3";
UART21.uart.$suggestSolution              = "UART3";
UART21.uart.txPin.$suggestSolution        = "boosterpack2.30";
UART21.uart.dmaTxChannel.$suggestSolution = "UDMA_CH17";
UART21.uart.rxPin.$suggestSolution        = "boosterpack2.29";
UART21.uart.dmaRxChannel.$suggestSolution = "UDMA_CH16";
